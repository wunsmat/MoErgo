/*
 * Copyright (c) 2020 The ZMK Contributors
 * Copyright (c) 2022 Innaworks Development Limited, trading as MoErgo
 *
 * SPDX-License-Identifier: MIT
 */
/* THIS FILE WAS GENERATED BY GLOVE80 LAYOUT EDITOR
 *
 * This file was generated automatically. You may or may not want to
 * edit it directly.
 */

#include <behaviors.dtsi>

#include "../zmk-nodefree-config/helper.h"
#include "../zmk-nodefree-config/keypos_def/keypos_glv80.h"

/* Include all behaviour includes needed by system behaviors/macros */
/* Include behaviour includes needed by key binds - automatically generated */

#include <dt-bindings/zmk/bt.h>
#include <dt-bindings/zmk/keys.h>
#include <dt-bindings/zmk/outputs.h>
#include <dt-bindings/zmk/rgb.h>

#define ___ &trans

#define DEF 0  // layer shortcuts, must match order in which they are defined below
#define LOW 1
#define MAG 2

/* Homerow mods */

#define KEYS_L LC1 LC2 LC3 LC4 LC5 LN0 LN1 LN2 LN3 LN4 LN5 LT0 LT1 LT2 LT3 LT4 LT5 LM0 LM1 LM2 LM3 LM4 LM5 LB0 LB1 LB2 LB3 LB4 LB5 LF1 LF2 LF3 LF4 LF5  // left hand
#define KEYS_R RC1 RC2 RC3 RC4 RC5 RN0 RN1 RN2 RN3 RN4 RN5 RT0 RT1 RT2 RT3 RT4 RT5 RM0 RM1 RM2 RM3 RM4 RM5 RB0 RB1 RB2 RB3 RB4 RB5 RF1 RF2 RF3 RF4 RF5  // right hand
#define THUMBS LH0 LH1 LH2 LH3 LH4 LH5 RH0 RH1 RH2 RH3 RH4 RH5                                                                                          // thumbs

#define MAKE_HRM(NAME, HOLD, TAP, TRIGGER_POS) \
    ZMK_BEHAVIOR(NAME, hold_tap, \
        flavor = "balanced"; \
        tapping-term-ms = <280>; \
        quick-tap-ms = <QUICK_TAP_MS>; \
        require-prior-idle-ms = <150>; \
        bindings = <HOLD>, <TAP>; \
        hold-trigger-key-positions = <TRIGGER_POS>; \
        hold-trigger-on-release; \
    )
MAKE_HRM(hml, &kp, &kp, KEYS_R THUMBS)  // left-hand HRMs
MAKE_HRM(hmr, &kp, &kp, KEYS_L THUMBS)  // right-hand HRMs

MAKE_HRM(hml_repeat, &kp, &key_repeat, KEYS_R THUMBS)  // used for HRM-combo
MAKE_HRM(hmr_lpar_lt, &kp, &lpar_lt, KEYS_L THUMBS)    // "    "   "   "
MAKE_HRM(hmr_rpar_gt, &kp, &rpar_gt, KEYS_L THUMBS)    // "    "   "   "

ZMK_BEHAVIOR(lower: tap_dance_0,
    compatible = "zmk,behavior-tap-dance";
    label = "LAYER_TAP_DANCE";
    #binding-cells = <0>;
    tapping-term-ms = <200>;
    bindings = <&mo 1>, <&to 1>;
)

/* Glove80 system behavior & macros */

ZMK_BEHAVIOR(rgb_ug_status_macro, rgb_ug_status_macro_0,
    label = "RGB_UG_STATUS";
    compatible = "zmk,behavior-macro";
    #binding-cells = <0>;
    bindings = <&rgb_ug RGB_STATUS>;
)

ZMK_BEHAVIOR(bt_0, bt_profile_macro_0,
    label = "BT_0";
    compatible = "zmk,behavior-macro";
    #binding-cells = <0>;
    bindings = <&out OUT_BLE &bt BT_SEL 0>;
)


ZMK_BEHAVIOR(bt_1, bt_profile_macro_1,
    label = "BT_1";
    compatible = "zmk,behavior-macro";
    #binding-cells = <0>;
    bindings = <&out OUT_BLE &bt BT_SEL 1>;
)

ZMK_BEHAVIOR(bt_2, bt_profile_macro_2,
    label = "BT_2";
    compatible = "zmk,behavior-macro";
    #binding-cells = <0>;
    bindings = <&out OUT_BLE &bt BT_SEL 2>;
)

ZMK_BEHAVIOR(bt_3, bt_profile_macro_3,
    label = "BT_3";
    compatible = "zmk,behavior-macro";
    #binding-cells = <0>;
    bindings = <&out OUT_BLE &bt BT_SEL 3>;
)

ZMK_BEHAVIOR(magic, magic_hold_tap,
    compatible = "zmk,behavior-hold-tap";
    label = "MAGIC_HOLD_TAP";
    #binding-cells = <2>;
    flavor = "tap-preferred";
    tapping-term-ms = <200>;
    bindings = <&mo>, <&rgb_ug_status_macro>;
)

GLV80_LAYER(base_layer,
/* ╭───────────────┬───────────────┬───────────────┬───────────────┬───────────────╮                                   ╭───────────────┬───────────────┬───────────────┬───────────────┬───────────────╮ */
    &kp F1          &kp F2          &kp F3          &kp F4          &kp F5                                              &kp F6          &kp F7          &kp F8          &kp F9          &kp F10
/* ├───────────────┼───────────────┼───────────────┼───────────────┼───────────────┼───────────────╮   ╭───────────────┼───────────────┼───────────────┼───────────────┼───────────────┼───────────────┤ */
    &kp EQUAL       &kp N1          &kp N2          &kp N3          &kp N4          &kp N5              &kp N6          &kp N7          &kp N8          &kp N9          &kp N0          &kp MINUS     
/* ├───────────────┼───────────────┼───────────────┼───────────────┼───────────────┼───────────────┤   ├───────────────┼───────────────┼───────────────┼───────────────┼───────────────┼───────────────┤ */
    &kp TAB         &kp Q           &kp W           &kp E           &kp R           &kp T               &kp Y           &kp U           &kp I           &kp O           &kp P           &kp BSLH 
/* ├───────────────┼───────────────┼───────────────┼───────────────┼───────────────┼───────────────┤   ├───────────────┼───────────────┼───────────────┼───────────────┼───────────────┼───────────────┤ */
    &kp ESC         &hml LSHFT A    &hml LCTRL S    &hml LGUI D     &hml LALT F     &lt 1 G             &lt 1 H         &hmr RALT J     &hmr RGUI K     &hmr LCTRL L    &hmr LCTRL L    &kp SQT
/* ├───────────────┼───────────────┼───────────────┼───────────────┼───────────────┼───────────────┤   ├───────────────┼───────────────┼───────────────┼───────────────┼───────────────┼───────────────┤ */
    &kp GRAVE       &kp Z           &kp X           &kp C           &kp V           &kp B            ,  &kp N           &kp M           &kp COMMA       &kp DOT         &kp FSLH        &kp PG_UP
/* ├───────────────┼───────────────┼───────────────┼───────────────┼───────────────┼───────────────╯   ╰───────────────┼───────────────┼───────────────┼───────────────┼───────────────┼───────────────┤ */
    &magic 2 0      &kp HOME        &kp END         &kp LEFT        &kp RIGHT                        ,                  &kp UP          &kp DOWN        &kp LBKT        &kp RBKT        &kp PG_DOWN
/* ╰───────────────┴───────────────┴───────────────┴───────────────┴───────────────╯                                   ╰───────────────┴───────────────┴───────────────┴───────────────┴───────────────╯ */
                                                                                                     ,
/*                                         ╭───────────────┬───────────────┬───────────────╮                   ╭───────────────┬───────────────┬───────────────╮                                         */
                                            &kp LSHFT       &kp LCTRL       &kp LGUI                            &lower          &kp RCTRL       &kp RSHFT
/*                                         ├───────────────┼───────────────┼───────────────┤      */ , /*      ├───────────────┼───────────────┼───────────────┤                                         */
                                            &kp BSPC        &kp DEL         &kp LALT                            &kp RALT        &kp RET         &kp SPACE
/*                                         ╰───────────────┴───────────────┴───────────────╯                   ╰───────────────┴───────────────┴───────────────╯                                         */
)

GLV80_LAYER(layer_Lower,
/* ╭───────────────┬───────────────┬───────────────┬───────────────┬───────────────╮                                   ╭───────────────┬───────────────┬───────────────┬───────────────┬───────────────╮ */
    &kp C_BRI_DN    &kp C_BRI_UP    &kp C_PREV      &kp C_NEXT      &kp C_PP                                            &kp C_MUTE      &kp C_VOL_DN    &kp C_VOL_UP    ___             &kp PAUSE_BREAK
/* ├───────────────┼───────────────┼───────────────┼───────────────┼───────────────┼───────────────╮   ╭───────────────┼───────────────┼───────────────┼───────────────┼───────────────┼───────────────┤ */
    ___             ___             ___             ___             ___             &kp HOME            ___             ___             ___             ___             ___             &kp PRINTSCREEN
/* ├───────────────┼───────────────┼───────────────┼───────────────┼───────────────┼───────────────┤   ├───────────────┼───────────────┼───────────────┼───────────────┼───────────────┼───────────────┤ */
    ___             &kp EXCL        &kp AT          &kp LBKT        &kp RBKT        &kp PIPE            &kp N1          &kp N2          &kp N3          &kp N4          &kp N5          &kp SCROLLLOCK
/* ├───────────────┼───────────────┼───────────────┼───────────────┼───────────────┼───────────────┤   ├───────────────┼───────────────┼───────────────┼───────────────┼───────────────┼───────────────┤ */
    ___             &kp HASH        &kp DLLR        &kp LPAR        &kp RPAR        &kp GRAVE           &kp N6          &kp N7          &kp N8          &kp N9          &kp N0          ___
/* ├───────────────┼───────────────┼───────────────┼───────────────┼───────────────┼───────────────┤   ├───────────────┼───────────────┼───────────────┼───────────────┼───────────────┼───────────────┤ */
    ___             &kp PRCNT       &kp CARET       &kp LBRC        &kp RBRC        &kp TILDE        ,  &kp KP_EQUAL    &kp KP_MULTIPLY &kp KP_PLUS     &kp KP_MINUS    &kp KP_SLASH    ___
/* ├───────────────┼───────────────┼───────────────┼───────────────┼───────────────┼───────────────╯   ╰───────────────┼───────────────┼───────────────┼───────────────┼───────────────┼───────────────┤ */
    &magic 2 0      &kp CAPS        &kp INS         &kp F11         &kp F12                          ,                  &kp DOT         ___             ___             ___             ___
/* ╰───────────────┴───────────────┴───────────────┴───────────────┴───────────────╯                                   ╰───────────────┴───────────────┴───────────────┴───────────────┴───────────────╯ */
                                                                                                     ,
/*                                         ╭───────────────┬───────────────┬───────────────╮                   ╭───────────────┬───────────────┬───────────────╮                                         */
                                            ___             ___             ___                                 ___             ___             ___
/*                                         ├───────────────┼───────────────┼───────────────┤      */ , /*      ├───────────────┼───────────────┼───────────────┤                                         */
                                            ___             ___             ___                                 ___             ___             ___
/*                                         ╰───────────────┴───────────────┴───────────────╯                   ╰───────────────┴───────────────┴───────────────╯                                         */
)

GLV80_LAYER(layer_Magic,
/* ╭───────────────┬───────────────┬───────────────┬───────────────┬───────────────╮                                   ╭───────────────┬───────────────┬───────────────┬───────────────┬───────────────╮ */
    &bt BT_CLR      ___             ___             ___             ___                                                 ___             ___             ___             ___             &bt BT_CLR_ALL
/* ├───────────────┼───────────────┼───────────────┼───────────────┼───────────────┼───────────────╮   ╭───────────────┼───────────────┼───────────────┼───────────────┼───────────────┼───────────────┤ */
    ___             ___             ___             ___             ___             ___                 ___             ___             ___             ___             ___             ___
/* ├───────────────┼───────────────┼───────────────┼───────────────┼───────────────┼───────────────┤   ├───────────────┼───────────────┼───────────────┼───────────────┼───────────────┼───────────────┤ */
    ___             &rgb_ug RGB_SPI &rgb_ug RGB_SAI &rgb_ug RGB_HUI &rgb_ug RGB_BRI &rgb_ug RGB_TOG     ___             ___             ___             ___             ___             ___
/* ├───────────────┼───────────────┼───────────────┼───────────────┼───────────────┼───────────────┤   ├───────────────┼───────────────┼───────────────┼───────────────┼───────────────┼───────────────┤ */
    &bootloader     &rgb_ug RGB_SPD &rgb_ug RGB_SAD &rgb_ug RGB_HUD &rgb_ug RGB_BRD &rgb_ug RGB_EFF     ___             ___             ___             ___             ___             &bootloader
/* ├───────────────┼───────────────┼───────────────┼───────────────┼───────────────┼───────────────┤   ├───────────────┼───────────────┼───────────────┼───────────────┼───────────────┼───────────────┤ */
    &reset          ___             ___             ___             ___             ___              ,  ___             ___             ___             ___             ___             &reset
/* ├───────────────┼───────────────┼───────────────┼───────────────┼───────────────┼───────────────╯   ╰───────────────┼───────────────┼───────────────┼───────────────┼───────────────┼───────────────┤ */
    ___             ___             ___             ___             ___                              ,                  ___             ___             ___             ___             ___
/* ╰───────────────┴───────────────┴───────────────┴───────────────┴───────────────╯                                   ╰───────────────┴───────────────┴───────────────┴───────────────┴───────────────╯ */
                                                                                                     ,
/*                                         ╭───────────────┬───────────────┬───────────────╮                   ╭───────────────┬───────────────┬───────────────╮                                         */
                                            &bt_2           &bt_3           ___                                 ___             ___             ___
/*                                         ├───────────────┼───────────────┼───────────────┤      */ , /*      ├───────────────┼───────────────┼───────────────┤                                         */
                                            &bt_0           &bt_1           &out OUT_USB                        ___             ___             ___
/*                                         ╰───────────────┴───────────────┴───────────────╯                   ╰───────────────┴───────────────┴───────────────╯                                         */
)
